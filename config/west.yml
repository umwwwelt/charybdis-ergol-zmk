## config/west.yml
```yaml
manifest:
  remotes:
    - name: zmkfirmware
      url-base: https://github.com/zmkfirmware
    - name: DoctorWangWang
      url-base: https://github.com/DoctorWangWang
    - name: zephyrproject
      url-base: https://github.com/zephyrproject-rtos
      
  projects:
    - name: zmk
      remote: zmkfirmware
      revision: v0.3
      import: app/west.yml
    - name: zephyr                    
      remote: zephyrproject
      revision: v3.5-branch    
    - name: zmk-pmw3610-driver
      remote: DoctorWangWang
      revision: main
      
  self:
    path: config
```
